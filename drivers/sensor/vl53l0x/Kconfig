## drivers/sensor/vl53l0x/Kconfig
```kconfig
# VL53L0X time of flight sensor configuration options

# Copyright (c) 2017 STMicroelectronics
# SPDX-License-Identifier: Apache-2.0

menuconfig VL53L0X
	bool "VL53L0X time of flight sensor"
	depends on I2C
	select HAS_STLIB
	help
	  Enable driver for VL53L0X I2C-based time of flight sensor.

config VL53L0X_PROXIMITY_THRESHOLD
	int "Proximity threshold in millimeters"
	default 100
	depends on VL53L0X
	help
	  Threshold used for proximity detection when sensor is used with SENSOR_CHAN_PROX.

config VL53L0X_RECONFIGURE_ADDRESS
	bool "Support reconfigurable sensor address"
	depends on VL53L0X
	help
	  Enable support for reconfiguring the sensor address at runtime.
	  When this option is enabled, all sensors declared in the device tree
	  must have an xshut-gpio property.

	  All sensors are disabled during initialization. When reading the first
	  value from a sensor, it is powered up and its I2C address is reconfigured
	  from the manufacturer default (0x29) to the address specified in the
	  device tree.

config VL53L0X_CONTINOUS_RANGE
	bool "Set up sensor for continous ranging"
	depends on VL53L0X
	help
	  Set up sensor in continous range mode instead of single shot.

config VL53L0X_GPIO_IN_RANGE
	bool "Use sensor GPIO pin to notify host that something is in distance less than VL53L0X_PROXIMITY_THRESHOLD"
	depends on VL53L0X_CONTINOUS_RANGE
	help
	  When enabled, polling for distance data will occur only if sensor sets its GPIO to active state.
	  Especially useful when connecting multiple sensors to the host to shorten time needed to poll all sensors.
	  Due to limitations as in UM2039 6.8. it depends on VL53L0X_CONTINOUS_RANGE.
```

## dts/bindings/sensor/st,vl53l0x.yaml
```yaml
# Copyright (c) 2017, Linaro Limited
# SPDX-License-Identifier: Apache-2.0

description: STMicroelectronics VL53L0X Time of Flight sensor

compatible: "st,vl53l0x"

include: i2c-device.yaml

properties:
    xshut-gpios:
      type: phandle-array
      required: false
      description: "GPIO used to shut sensor down"
    gpio1-gpios:
      type: phandle-array
      required: false
      description: "GPIO used to check if sensor value is in range"
```
